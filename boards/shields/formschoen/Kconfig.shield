## boards/shields/formschoen/Kconfig.shield
```kconfig
config SHIELD_FORMSCHOEN_LEFT
    def_bool $(shields_list_contains,formschoen_left)

config SHIELD_FORMSCHOEN_RIGHT
    def_bool $(shields_list_contains,formschoen_right)
```
